## CMakeLists.txt
```
cmake_minimum_required(VERSION 3.20.0)

# Allow using snippets defined in applications/uart_simulation/snippets via -S <name>.
list(APPEND SNIPPET_ROOT ${CMAKE_CURRENT_SOURCE_DIR})

find_package(Zephyr REQUIRED HINTS $ENV{ZEPHYR_BASE})
project(uart_simulation)

target_sources(app PRIVATE src/main.c src/commands.c)
```

## prj.conf
```kconfig
# Enabling logging for the message queues application
CONFIG_LOG=y

CONFIG_CONSOLE=y

CONFIG_SHELL=y
CONFIG_SHELL_STACK_SIZE=2048
CONFIG_SHELL_BACKEND_SERIAL=y
CONFIG_SHELL_BACKEND_SERIAL_INIT_PRIORITY=50
```

## src/main.c
```c
#include <stdio.h>

#include <zephyr/logging/log.h>

LOG_MODULE_REGISTER(main, LOG_LEVEL_INF);

int main(void)
{
    LOG_INF("Hello, this is a UART simulation!");
    return 0;
}
```
