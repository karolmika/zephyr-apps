## CMakeLists.txt
```
cmake_minimum_required(VERSION 3.20.0)

find_package(Zephyr REQUIRED HINTS $ENV{ZEPHYR_BASE})
project(s14_challenge)

target_sources(app PRIVATE main.cpp src/MyStrings.cpp)

target_include_directories(app PRIVATE inc)
```

## prj.conf
```kconfig
CONFIG_CPP=y
CONFIG_CONSOLE=y
CONFIG_STDOUT_CONSOLE=y
CONFIG_PRINTK=y
CONFIG_REQUIRES_FULL_LIBCPP=y
```

## inc/MyStrings.h
```c
#ifndef _MYSTRING_H_
#define _MYSTRING_H_

class MyString {
    private:
        char *str;

    public:
        MyString();                         // Constructor
        MyString(const char *s);            // Overloaded constructor
        MyString(const MyString &src);      // Copy constructor
        MyString(MyString &&src);           // Move constructor
        ~MyString();                        // Destructor

        void display() const;               // const allows call display() on const objects
        const char *get_str() const;
        int get_length() const;
};

#endif //_MYSTRING_H_
```

## src/MyStrings.cpp
```c
#include <iostream>
#include <cstring>
#include "MyStrings.h"

// No-args constructor
MyString::MyString() 
    : str{nullptr} {
}

// Overloaded constructor
MyString::MyString(const char *sin) : str{nullptr} {
    str = new char[std::strlen(sin) + 1];
    std::strcpy(str, sin);
}

// Copy constructor

// Move constructor

// Destructor
MyString::~MyString() {
    delete [] str;
}

// Copy assigment

// Move assigment

// Display method

// Getters
const char *MyString::get_str() const{
    return this->str;
}
```
