## CMakeLists.txt
```
cmake_minimum_required(VERSION 3.20.0)

find_package(Zephyr REQUIRED HINTS $ENV{ZEPHYR_BASE})
project(s13_challenge)

target_sources(app PRIVATE 
    src/main.cpp
    src/movie.cpp
    src/movies.cpp
)
target_include_directories(app PRIVATE inc)
```

## prj.conf
```kconfig
CONFIG_CPP=y
CONFIG_STDOUT_CONSOLE=y
CONFIG_CONSOLE=y
CONFIG_PRINTK=y
CONFIG_REQUIRES_FULL_LIBCPP=y
```

## src/main.cpp
```c
#include <iostream>
#include <string>
#include "Movies.hpp"

int main(void) {
    std::cout << "hello" << std:endl;
    exit(0);
    return(0);
}
```

## inc/Movie.hpp
```c
#include <string>

class Movie {
private:
    std::string name;
    int rate;   // x/10
    int count;  // watched counter
public:
    Movie(const std::string& name, int rate, int count);

    std::string get_name() {
        return name;
    } 
    int get_rate(){
        return rate;
    }
    int get_count() {
        return count;
    }

    void set_count(int cnt) {
        count = cnt;
    }

    void inc_count() {
        count = count+1;
    }
};
```

## inc/Movies.hpp
```c
#include <vector>
#include <string>
#include "Movie.hpp"

class Movies {
private:
    std::vector <Movie> movies;
public:
    /**
     * @brief It will search the movies vector to see if a movie already exists,
     *        if it does then return fals. Otherwise, create a movie object from
     *        provided information
     * @param name Name of the movie
     * @param rate Initial rate of the movie
     * @param count Initial watch counter for the movie
     * 
     * @return -1 if movie already exists, otherwise 0 (movie added)
     */
    int add_movie(const std::string& name, int rate, int count);

    /**
     * @brief Read movie from the vector list baded on the provided movie name.
     * @param name Name of the movie 
     * @return Pointer to Movie object in the vector list or NULL ptr if movie
     *         is not exisiting. 
     */
    Movie* get_movie(const std::string& name);

    /**
     * @brief Increment watch counter for the provided movie name. Function first
     *        check if movie exists.
     * @param name Name of the movie
     */
    void inc_watch_count(const std::string& name);

    /**
     * @brief Loops through all movie objects an reads the name to collect them as
     *        one single string. Each name is seperated by a colon (,) i.ex.
     *        Movie1, Movie2, Movie3 ...  
     */
    std::string display();
    
};
```

## src/movie.cpp
```c
#include "Movie.hpp"

Movie::Movie(const std::string& name, int rate, int count)
    : name{name}, rate{rate}, count{count} {
}
```

## src/movies.cpp
```c
#include <iostream>
#include <string>
#include "Movies.hpp"

int Movies::add_movie(const std::string& name, int rate, int count) {
    for (Movie movie: movies) {
        if (name == movie.get_name()) {
            return -1;
        }
    }

    Movie m{name, rate, count};
    movies.push_back(m);
    return 0;
}

Movie* Movies::get_movie(const std::string& name) {
    for (auto it = this->movies.begin(); it != this->movies.end(); ++it)
    {
        if (name == it->get_name())
        {
            return &*it;
        }
    }
    return nullptr;
}

void Movies::inc_watch_count(const std::string& name) {
    Movie* movie = get_movie(name);

    if (movie != nullptr) {
        movie->inc_count();
    } else {
        std::cout << "ERROR: Movie with given name {" << name << "} is not on the list." << std::endl;
    }
}

std::string Movies::display(void) {
    std::string movies_names {};
    int s = this->movies.size();
    int cnt = 0;

    for (auto it = this->movies.begin(); it != this->movies.end(); ++it) {
        if (++cnt != s) {
            movies_names += ( it->get_name() + ", ");
        }
        else {
            movies_names += it->get_name();
        }

    }
    return movies_names;
}
```
