## tests/unit_tests/s13_challenge_test/testcase.yaml
```yaml
tests:
  application.s13_challenge:
    tags:
      - unit
      - cpp
    platform_allow:
      - native_sim
    integration_platforms:
      - native_sim
    harness: ztest
```

## tests/unit_tests/s14_challenge_ut/testcase.yaml
```yaml
tests:
  app.s14_unit_tests:
    tags:
      - unit
      - cpp
    platform_allow:
      - native_sim
    integration_platforms:
      - native_sim
    harness: ztest  
```
