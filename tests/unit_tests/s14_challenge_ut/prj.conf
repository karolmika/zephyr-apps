## CMakeLists.txt
```
cmake_minimum_required(VERSION 3.20.0)

find_package(Zephyr REQUIRED HINTS $ENV{ZEPHYR_BASE})

project(s14_challenge_ut)

target_sources(app PRIVATE
    src/main.cpp
    ../../../applications/s14_challenge/src/MyStrings.cpp
     )

target_include_directories(app PRIVATE
    ../../../applications/s14_challenge/inc
)
```

## prj.conf
```kconfig
CONFIG_ZTEST=y
CONFIG_CPP=y
CONFIG_REQUIRES_FULL_LIBCPP=y
```

## src/main.cpp
```c
#include <zephyr/ztest.h>
#include <cstring>
#include "MyStrings.h"

/* Add new movie, read it back and check if the data are correct (movie sucesfully added)*/
ZTEST(s14_challenge_test, test_init)
{
    MyString ms {"Karol"};
    zassert_equal(std::strcmp(ms.get_str(), "Karol"), 0, "Add movie return error!");
}

ZTEST_SUITE(s14_challenge_test, NULL, NULL, NULL, NULL, NULL);
```
